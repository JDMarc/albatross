#pragma once
#include "airshot_config.h"
namespace airshot {
constexpr uint16_t FIELD_COUNT=133;
inline bool setField(Config& c,uint16_t id,float value) {
 if(!isfinite(value) || value < -1 || value>1000000) return false;
 switch(id) {
 case 0: if(value!=0 && value!=1) return false; c.validated=static_cast<bool>(value);return true;
 case 1: if(value<0 || value!=floorf(value) || value>9) return false; c.stage=static_cast<uint32_t>(value);return true;
 case 2: if(value!=0 && value!=1) return false; c.auto_shadow=static_cast<bool>(value);return true;
 case 3: if(value!=0 && value!=1) return false; c.require_wmi=static_cast<bool>(value);return true;
 case 4: if(value!=floorf(value) || value>41) return false; c.fire_pin=static_cast<int>(value);return true;
 case 5: if(value!=floorf(value) || value>41) return false; c.service_pin=static_cast<int>(value);return true;
 case 6: if(value<0 || value!=floorf(value)) return false; c.recovery_ms=static_cast<uint32_t>(value);return true;
 case 7: if(value<0 || value!=floorf(value)) return false; c.budget_window_ms=static_cast<uint32_t>(value);return true;
 case 8: if(value<0 || value!=floorf(value)) return false; c.budget_ms=static_cast<uint32_t>(value);return true;
 case 9: if(value<0 || value!=floorf(value)) return false; c.taper_ms=static_cast<uint32_t>(value);return true;
 case 10: c.rpm_min=static_cast<float>(value);return true;
 case 11: c.rpm_max=static_cast<float>(value);return true;
 case 12: c.launch_rpm=static_cast<float>(value);return true;
 case 13: c.high_rpm=static_cast<float>(value);return true;
 case 14: c.min_tank=static_cast<float>(value);return true;
 case 15: c.full_tank=static_cast<float>(value);return true;
 case 16: c.min_regulated=static_cast<float>(value);return true;
 case 17: c.max_regulated=static_cast<float>(value);return true;
 case 18: c.min_headroom=static_cast<float>(value);return true;
 case 19: c.min_torque=static_cast<float>(value);return true;
 case 20: c.dbw_tolerance=static_cast<float>(value);return true;
 case 21: c.min_coolant=static_cast<float>(value);return true;
 case 22: c.min_oil=static_cast<float>(value);return true;
 case 23: c.boost_start=static_cast<float>(value);return true;
 case 24: c.boost_done=static_cast<float>(value);return true;
 case 25: c.boost_full=static_cast<float>(value);return true;
 case 26: c.spool_rate=static_cast<float>(value);return true;
 case 27: c.overboost_margin=static_cast<float>(value);return true;
 case 28: c.transient_rate=static_cast<float>(value);return true;
 case 29: c.auto_start=static_cast<float>(value);return true;
 case 30: c.auto_reset=static_cast<float>(value);return true;
 case 31: c.wg_open_limit=static_cast<float>(value);return true;
 case 32: c.balance_limit=static_cast<float>(value);return true;
 case 33: c.thermal_egt=static_cast<float>(value);return true;
 case 34: c.thermal_turbine=static_cast<float>(value);return true;
 case 35: c.thermal_charge=static_cast<float>(value);return true;
 case 36: c.thermal_ic=static_cast<float>(value);return true;
 case 37: c.thermal_head=static_cast<float>(value);return true;
 case 38: c.gear[0]=static_cast<float>(value);return true;
 case 39: c.gear[1]=static_cast<float>(value);return true;
 case 40: c.gear[2]=static_cast<float>(value);return true;
 case 41: c.gear[3]=static_cast<float>(value);return true;
 case 42: c.gear[4]=static_cast<float>(value);return true;
 case 43: c.gear[5]=static_cast<float>(value);return true;
 case 44: c.gear[6]=static_cast<float>(value);return true;
 case 45: c.fuel[0]=static_cast<float>(value);return true;
 case 46: c.fuel[1]=static_cast<float>(value);return true;
 case 47: c.fuel[2]=static_cast<float>(value);return true;
 case 48: c.fuel[3]=static_cast<float>(value);return true;
 case 49: c.fuel[4]=static_cast<float>(value);return true;
 case 50: c.fuel[5]=static_cast<float>(value);return true;
 case 51: c.ride[0]=static_cast<float>(value);return true;
 case 52: c.ride[1]=static_cast<float>(value);return true;
 case 53: c.ride[2]=static_cast<float>(value);return true;
 case 54: c.ride[3]=static_cast<float>(value);return true;
 case 55: c.ride[4]=static_cast<float>(value);return true;
 case 56: c.ride[5]=static_cast<float>(value);return true;
 case 57: c.rpm_axis[0]=static_cast<float>(value);return true;
 case 58: c.rpm_axis[1]=static_cast<float>(value);return true;
 case 59: c.rpm_axis[2]=static_cast<float>(value);return true;
 case 60: c.rpm_axis[3]=static_cast<float>(value);return true;
 case 61: c.rpm_gain[0]=static_cast<float>(value);return true;
 case 62: c.rpm_gain[1]=static_cast<float>(value);return true;
 case 63: c.rpm_gain[2]=static_cast<float>(value);return true;
 case 64: c.rpm_gain[3]=static_cast<float>(value);return true;
 case 65: if(value!=floorf(value) || value>41) return false; c.valves[0].pin=static_cast<int>(value);return true;
 case 66: if(value<0 || value!=floorf(value)) return false; c.valves[0].pwm_hz=static_cast<uint32_t>(value);return true;
 case 67: c.valves[0].minimum=static_cast<float>(value);return true;
 case 68: c.valves[0].maximum=static_cast<float>(value);return true;
 case 69: c.valves[0].trim=static_cast<float>(value);return true;
 case 70: c.valves[0].opening_ms=static_cast<float>(value);return true;
 case 71: c.valves[0].closing_ms=static_cast<float>(value);return true;
 case 72: c.valves[0].flow_coefficient=static_cast<float>(value);return true;
 case 73: c.valves[0].min_current=static_cast<float>(value);return true;
 case 74: c.valves[0].max_current=static_cast<float>(value);return true;
 case 75: c.valves[0].pressure_reference=static_cast<float>(value);return true;
 case 76: if(value!=floorf(value) || value>41) return false; c.valves[1].pin=static_cast<int>(value);return true;
 case 77: if(value<0 || value!=floorf(value)) return false; c.valves[1].pwm_hz=static_cast<uint32_t>(value);return true;
 case 78: c.valves[1].minimum=static_cast<float>(value);return true;
 case 79: c.valves[1].maximum=static_cast<float>(value);return true;
 case 80: c.valves[1].trim=static_cast<float>(value);return true;
 case 81: c.valves[1].opening_ms=static_cast<float>(value);return true;
 case 82: c.valves[1].closing_ms=static_cast<float>(value);return true;
 case 83: c.valves[1].flow_coefficient=static_cast<float>(value);return true;
 case 84: c.valves[1].min_current=static_cast<float>(value);return true;
 case 85: c.valves[1].max_current=static_cast<float>(value);return true;
 case 86: c.valves[1].pressure_reference=static_cast<float>(value);return true;
 case 87: if(value!=floorf(value) || value>41) return false; c.valves[2].pin=static_cast<int>(value);return true;
 case 88: if(value<0 || value!=floorf(value)) return false; c.valves[2].pwm_hz=static_cast<uint32_t>(value);return true;
 case 89: c.valves[2].minimum=static_cast<float>(value);return true;
 case 90: c.valves[2].maximum=static_cast<float>(value);return true;
 case 91: c.valves[2].trim=static_cast<float>(value);return true;
 case 92: c.valves[2].opening_ms=static_cast<float>(value);return true;
 case 93: c.valves[2].closing_ms=static_cast<float>(value);return true;
 case 94: c.valves[2].flow_coefficient=static_cast<float>(value);return true;
 case 95: c.valves[2].min_current=static_cast<float>(value);return true;
 case 96: c.valves[2].max_current=static_cast<float>(value);return true;
 case 97: c.valves[2].pressure_reference=static_cast<float>(value);return true;
 case 98: if(value!=floorf(value) || value>41) return false; c.valves[3].pin=static_cast<int>(value);return true;
 case 99: if(value<0 || value!=floorf(value)) return false; c.valves[3].pwm_hz=static_cast<uint32_t>(value);return true;
 case 100: c.valves[3].minimum=static_cast<float>(value);return true;
 case 101: c.valves[3].maximum=static_cast<float>(value);return true;
 case 102: c.valves[3].trim=static_cast<float>(value);return true;
 case 103: c.valves[3].opening_ms=static_cast<float>(value);return true;
 case 104: c.valves[3].closing_ms=static_cast<float>(value);return true;
 case 105: c.valves[3].flow_coefficient=static_cast<float>(value);return true;
 case 106: c.valves[3].min_current=static_cast<float>(value);return true;
 case 107: c.valves[3].max_current=static_cast<float>(value);return true;
 case 108: c.valves[3].pressure_reference=static_cast<float>(value);return true;
 case 109: c.profiles[0].intake=static_cast<float>(value);return true;
 case 110: c.profiles[0].turbine=static_cast<float>(value);return true;
 case 111: c.profiles[0].intake_decay=static_cast<float>(value);return true;
 case 112: if(value<0 || value!=floorf(value)) return false; c.profiles[0].maximum_ms=static_cast<uint32_t>(value);return true;
 case 113: c.profiles[1].intake=static_cast<float>(value);return true;
 case 114: c.profiles[1].turbine=static_cast<float>(value);return true;
 case 115: c.profiles[1].intake_decay=static_cast<float>(value);return true;
 case 116: if(value<0 || value!=floorf(value)) return false; c.profiles[1].maximum_ms=static_cast<uint32_t>(value);return true;
 case 117: c.profiles[2].intake=static_cast<float>(value);return true;
 case 118: c.profiles[2].turbine=static_cast<float>(value);return true;
 case 119: c.profiles[2].intake_decay=static_cast<float>(value);return true;
 case 120: if(value<0 || value!=floorf(value)) return false; c.profiles[2].maximum_ms=static_cast<uint32_t>(value);return true;
 case 121: c.profiles[3].intake=static_cast<float>(value);return true;
 case 122: c.profiles[3].turbine=static_cast<float>(value);return true;
 case 123: c.profiles[3].intake_decay=static_cast<float>(value);return true;
 case 124: if(value<0 || value!=floorf(value)) return false; c.profiles[3].maximum_ms=static_cast<uint32_t>(value);return true;
 case 125: c.profiles[4].intake=static_cast<float>(value);return true;
 case 126: c.profiles[4].turbine=static_cast<float>(value);return true;
 case 127: c.profiles[4].intake_decay=static_cast<float>(value);return true;
 case 128: if(value<0 || value!=floorf(value)) return false; c.profiles[4].maximum_ms=static_cast<uint32_t>(value);return true;
 case 129: c.profiles[5].intake=static_cast<float>(value);return true;
 case 130: c.profiles[5].turbine=static_cast<float>(value);return true;
 case 131: c.profiles[5].intake_decay=static_cast<float>(value);return true;
 case 132: if(value<0 || value!=floorf(value)) return false; c.profiles[5].maximum_ms=static_cast<uint32_t>(value);return true;
 default:return false;
 }
}
}
